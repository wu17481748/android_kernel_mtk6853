## drivers/net/wireless/realtek/rtl8xxxu/Kconfig.rej
```kconfig
--- drivers/net/wireless/realtek/rtl8xxxu/Kconfig
+++ drivers/net/wireless/realtek/rtl8xxxu/Kconfig
@@ -1,8 +1,9 @@
+# SPDX-License-Identifier: GPL-2.0-only
 #
 # RTL8XXXU Wireless LAN device configuration
 #
 config RTL8XXXU
-	tristate "RTL8723AU/RTL8188[CR]U/RTL819[12]CU (mac80211) support"
+	tristate "RTL8723AU/RTL8188[EU/CR]U/RTL819[12]CU (mac80211) support"
 	depends on MAC80211 && USB
 	---help---
 	  This is an alternative driver for various Realtek RTL8XXX
```

## include/linux/sched_assist/Kconfig
```kconfig
config OPLUS_FEATURE_SCHED_ASSIST
	tristate "sched_assist"
	default n
	help
	  turning sched for ui, render and so on to improve UX
config OPLUS_FEATURE_SCHED_SPREAD
	bool "sched_spread"
	default n
	help
	  This is the uifirst 5.0 feature, which will spread tasks,
	  kick runnable time from task demand and adjust bg's time slice.
config OPLUS_UX_IM_FLAG
	bool "config ux im_flag"
	default n
	help
	  export im_flag proc node for mark thread.
config OPLUS_FEATURE_AUDIO_OPT
        bool "config audio opt"
        default n
        help
          audio task schedule opt
config MMAP_LOCK_OPT
        bool "config mmap lock opt"
        default n
        depends on OPLUS_FEATURE_SCHED_ASSIST
        help
          reduce sleep time in mmap lock
config OPLUS_ALLBOOST_OPT
        bool "config allboost opt"
        default n
        help
          Make the SCHED_ALL_BOOST function take effect
```

## kernel/prefer_silver/Kconfig
```kconfig
config OPLUS_PREFER_SILVER
	default n
	bool "a task placement decision for non-ui task"
	help
	  task placement decision feature for non-ui task
```

## sound/soc/codecs/audio/Kconfig
```kconfig
#
# oplus extend audio codec configuration
#

config SIA_PA_ALGO
	bool "Use SIA PA ALGO"
	default n

#ifdef OPLUS_BUG_COMPATIBILITY
config SND_SOC_CODEC_AW87339
	bool "Use AW87339 As PA"
	default n
#endif /* OPLUS_BUG_COMPATIBILITY */

config SND_TFA98XX_I2C_ADD_REVERSE
	bool "I2C is REVERSE"
	default n

#ifdef OPLUS_ARCH_EXTENDS
config SND_SOC_AW87XXX
       bool "Use AW87xxx As PA"
       default n

       config SND_SOC_OPLUS_PA_MANAGER
       bool "add PA manager"
       default n
#endif /* OPLUS_ARCH_EXTENDS */

#ifdef OPLUS_BUG_COMPATIBILITY
config SND_SOC_DBMDX
	bool "Use DBMDX As Sound Card"
	default n

source sound/soc/codecs/audio/dbmdx/Kconfig
#endif /* OPLUS_BUG_COMPATIBILITY */

config SND_SOC_CODEC_AW87418
	bool "SoC Audio for awinic AW87XXX Smart K PA"
	default n
```
